/***********************************************************************************************************************************
 ** 购买链接】  魔女开发板    https://demoboard.taobao.com
 ***********************************************************************************************************************************
 **【文件名称】  bsp_24Cxx.c
 **【文件功能】  
 **
 **【适用平台】  STM32F103 + 标准库v3.5 + keil5
 **
 **【函数简介】          
 **              
 **
 **【更新记录】  2020-03-05  创建
 **              2021-05-03  完善文件格式、注释格式
 ** 
************************************************************************************************************************************/
#include "bsp_24Cxx.h"  




#define AT24C01		127
#define AT24C02		255
#define AT24C04		511
#define AT24C08		1023
#define AT24C16		2047
#define AT24C32		4095
#define AT24C64	    8191
#define AT24C128	16383
#define AT24C256	32767  


// 声明全局变量,方便记录数据
xAT24Cxx_TypeDef  xAT24Cxx;	 



// 本地US粗略延时函数，减少移植时对外部文件依赖；
static void delayUs( u32 times)
{
    times=times*7;    
	while(--times)  	   
        __nop();  
}

// 本地MS粗略延时函数，减少移植时对外部文件依赖；
static void delayMs(u32 ms)
{
    ms=ms*7979;                  
    for(u32 i=0; i<ms; i++);         // 72MHz系统时钟下，每7979个空循环约耗时1ms
}





/******************************************************************************
 * 函数名： AT24Cxx_ReadByte
 * 功  能： 读取从机地址addr的1个字节
 * 参  数： uint16_t addr   将读取的地址         
 *          uint8_t* data   数据缓存
 * 返  回： 0-检测成功    1-检测失败
 ******************************************************************************/  
uint8_t AT24Cxx_ReadByte(uint16_t addr, uint8_t* data)
{				  
    if(IICSoft_ReadByte(AT24Cxx_ADDR, addr, data))
        return 1;     // 失败
    else
        return 0;     // 成功
}

/******************************************************************************
 * 函数名： AT24Cxx_ReadBuffer
 * 功  能： 读取从机指定地址的多个字节
 * 参  数： uint16_t addr   将写入的地址         
 *          uint8_t* data   数据缓存
 *          uint16_t len
 * 返  回： 0-检测成功    1-检测失败
 ******************************************************************************/ 
uint8_t AT24Cxx_ReadBuffer(uint16_t addr, uint8_t* buf, uint16_t len)
{   
    if(IICSoft_ReadBueffer(AT24Cxx_ADDR, addr, buf, len))
        return 1;     // 失败
    else
        return 0;     // 成功	
}  

/******************************************************************************
 * 函数名： AT24Cxx_WriteByte
 * 功  能： 向从机的指定地址，写入1个字节
 * 参  数： uint16_t addr   将写入的地址         
 *          uint8_t* data   数据缓存
 * 返  回： 0-检测成功    1-检测失败
 ******************************************************************************/ 
uint8_t AT24Cxx_WriteByte(uint16_t addr, uint8_t data)
{	
    uint8_t state = IICSoft_WriteByte(AT24Cxx_ADDR, addr, data);     
    delayMs(5);               // 24c02的写入比较耗时, 写入后, 要适当延时    
    if(state)   return 1;     // 失败
    else        return 0;     // 成功	 
}

/******************************************************************************
 * 函数名： AT24Cxx_WriteBuffer
 * 功  能： 向从机的指定地址, 连续写入多个字节
 * 参  数： 
 *          
 * 返  回： 0-失败, 1-成功    
 ******************************************************************************/ 
uint8_t AT24Cxx_WriteBuffer(uint16_t addr, uint8_t* buf, uint16_t len)
{ 
    while(len--)
    {    
        if(AT24Cxx_WriteByte(addr++, *buf++))
            return 1;   // 成功
    }       
    return 0;           // 失败
}



/******************************************************************************
 * 函数名： AT24Cxx_Check
 * 功  能： 检查AT24CXX是否正常
 * 参  数： 
 *          
 * 返  回： 0-检测成功    1-检测失败
 ******************************************************************************/ 
static uint8_t check(void)
{    
    uint8_t oldData=0, newData=0;
    
	if(1== AT24Cxx_ReadByte(1, &oldData))   // 尝试读取特定位置数据		   
        return 1;                           // 如果读取失败, 返回1
	                           
	if(1== AT24Cxx_WriteByte(1, 0XAC))      // 尝试写入新数据
        return 1;                           // 如果读取失败, 返回1
    
	if(1== AT24Cxx_ReadByte(1, &newData))   // 尝试读取刚写入的新数据
        return 1;                           // 如果读取失败, 返回1

    if(newData!=0xAC)                       // 对比写入后读取的数据,是否与原数据相同
        return 1;
        
    if(1== AT24Cxx_WriteByte(1, oldData))   // 尝试写回原数据, 避免破坏原存储的数据
        return 1;                           // 如果读取失败, 返回1	   
}



/******************************************************************************
 * 函数名： AT24Cxx_Init
 * 功  能： 初始化IIC总线、测试读写
 * 参  数： 
 *          
 * 返  回： 0-检测成功    1-检测失败
 ******************************************************************************/ 
uint8_t AT24Cxx_Init(void)
{		  
    xAT24Cxx.initOK = 0;          // 初始化成功标志, 0-未初始化, 1-已初始化成功
    
    IICSoft_Init();               // 初始化模块IIC通信所用引脚
    
    if(check())
    {
        printf("AT24Cxx 检测...       失败\r\n");
        return 1;
    }
    else
    {
        printf("AT24Cxx 检测...       正常\r\n");
        xAT24Cxx .initOK =1; 
        return 0;
    }    
}


